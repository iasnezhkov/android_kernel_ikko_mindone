## mindone/Kconfig.ext
```kconfig
# SPDX-License-Identifier: GPL-2.0
# SPDX-FileCopyrightText: 2026 The LineageOS Project
config MINDONE_DRM_HELPERS
	tristate "MindOne DRM display and GEM DMA helper modules"
	depends on DRM
	select DRM_DISPLAY_HELPER
	select DRM_DISPLAY_DP_HELPER
	select DRM_GEM_DMA_HELPER
	help
	  Builds drm_display_helper.ko and drm_dma_helper.ko from the
	  unmodified ACK sources for the out-of-tree MediaTek display driver.

config MINDONE_PINCTRL_MTK_PARIS
	tristate "MindOne MediaTek paris pinctrl library modules"
	depends on OF
	select PINCTRL_MTK_PARIS
	help
	  Builds pinctrl-paris.ko, pinctrl-mtk-common-v2.ko and mtk-eint.ko
	  from the unmodified ACK sources for the out-of-tree MT6789 pinctrl
	  data driver.
```
