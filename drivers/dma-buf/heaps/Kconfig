## drivers/dma-buf/heaps/Kconfig
```kconfig
menuconfig DMABUF_HEAPS_DEFERRED_FREE
	tristate "DMA-BUF heaps deferred-free library"
	help
	  Choose this option to enable the DMA-BUF heaps deferred-free library.

menuconfig DMABUF_HEAPS_PAGE_POOL
	tristate "DMA-BUF heaps page-pool library"
	help
	  Choose this option to enable the DMA-BUF heaps page-pool library.

config DMABUF_HEAPS_SYSTEM
	tristate "DMA-BUF System Heap"
	depends on DMABUF_HEAPS
	select DMABUF_HEAPS_PAGE_POOL
	help
	  Choose this option to enable the system dmabuf heap. The system heap
	  is backed by pages from the buddy allocator. If in doubt, say Y.

config DMABUF_HEAPS_CMA
	tristate "DMA-BUF CMA Heap"
	depends on DMABUF_HEAPS && DMA_CMA
	help
	  Choose this option to enable dma-buf CMA heap. This heap is backed
	  by the Contiguous Memory Allocator (CMA). If your system has these
	  regions, you should say Y here.

config DMABUF_HEAPS_TEGRA_VPR_INIT
	bool "NVIDIA Tegra VPR reserved-memory initialization"
	depends on DMABUF_HEAPS && DMA_CMA
	help
	  Initialize the reserved-memory region used by the NVIDIA Tegra Video
	  Protection Region (VPR). This must be built into the kernel so a
	  vendor module can provide the VPR DMA-BUF heap after early boot.
```

## mindone/Kconfig.ext
```kconfig
# SPDX-License-Identifier: GPL-2.0
# SPDX-FileCopyrightText: 2026 The LineageOS Project
config MINDONE_DRM_HELPERS
	tristate "MindOne DRM display and GEM DMA helper modules"
	depends on DRM
	select DRM_DISPLAY_HELPER
	select DRM_GEM_DMA_HELPER
	help
	  Builds drm_display_helper.ko and drm_dma_helper.ko from the
	  unmodified ACK sources for the out-of-tree MediaTek display driver.
```

## mindone/modules/mddp/Kconfig
```kconfig
# SPDX-License-Identifier: GPL-2.0
# SPDX-FileCopyrightText: 2026 The LineageOS Project
config MTK_MDDP_SUPPORT
	tristate "MediaTek modem direct path"
	depends on NET && INET && IPV6 && NETFILTER
	help
	  Provides the MediaTek modem direct path control device.
```
